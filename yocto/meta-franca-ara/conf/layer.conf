## yocto/meta-franca-ara/conf/layer.conf
```bitbake
BBPATH ?= ""
# We add conf directory to BBPATH
BBPATH .= ":${LAYERDIR}"

# We have a recipes directory containing .bb and .bbappend files, add to BBFILES
BBFILES += "${LAYERDIR}/recipes-*/*/*.bb \
            ${LAYERDIR}/recipes-*/*/*.bbappend"

BBFILE_COLLECTIONS += "franca-ara"
BBFILE_PATTERN_franca-ara := "^${LAYERDIR}/"
BBFILE_PRIORITY_franca-ara = "10"
LAYERSERIES_COMPAT_franca-ara = "sumo"
LAYERDEPENDS_franca-ara = "genivi-dev"
```
