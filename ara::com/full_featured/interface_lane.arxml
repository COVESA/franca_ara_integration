AUTOSAR XML (schema 4.0)
package /genivi/aasr/showcase
  service interface IDrivingLane
    namespaces:
      symbol props genivi
      symbol props aasr
      symbol props showcase
    events:
      data LaneDetected: type=LaneType
  impl type LaneType: category=STRUCTURE
    8 x element, all with category=TYPE_REFERENCE:
      frameId: implementation-data-type=UInt16
      frameHash: implementation-data-type=String
      lowerLeftPointX: implementation-data-type=UInt32
      lowerLeftPointY: implementation-data-type=UInt32
      lowerRightPointX: implementation-data-type=UInt32
      lowerRightPointY: implementation-data-type=UInt32
      intersectionPointX: implementation-data-type=UInt32
      intersectionPointY: implementation-data-type=UInt32
  implementation data type extension LaneTypeExt: implementation-data-type=LaneType
    namespaces:
      symbol props genivi
      symbol props aasr
      symbol props showcase
