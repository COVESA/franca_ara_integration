AUTOSAR XML (schema 4.0)
package /genivi/aasr/showcase
  impl type BoundingBox: category=STRUCTURE
    4 x element, all with category=TYPE_REFERENCE, implementation-data-type=UInt32:
      topLeftX
      topLeftY
      width
      height
  implementation data type extension BoundingBoxExt: implementation-data-type=BoundingBox
    namespaces:
      symbol props genivi
      symbol props aasr
      symbol props showcase
  impl type BoundingBoxes: category=ASSOCIATIVE_MAP
    element keyType: implementation-data-type=UInt8
    element valueType: implementation-data-type=BoundingBox
  implementation data type extension BoundingBoxesExt: implementation-data-type=BoundingBoxes
    namespaces:
      symbol props genivi
      symbol props aasr
      symbol props showcase
  impl type FlexibleFloatingPoint: category=STRUCTURE
    element floatingPoint32Bit: implementation-data-type=Float
    element floatingPoint64Bit: implementation-data-type=Double
  impl type FlexibleFloatingPointContainer: category=STRUCTURE
    element precision: implementation-data-type=FloatingPointPrecision
    element floatingPoint: implementation-data-type=FlexibleFloatingPoint
  implementation data type extension FlexibleFloatingPointContainerExt: implementation-data-type=FlexibleFloatingPointContainer
    namespaces:
      symbol props genivi
      symbol props aasr
      symbol props showcase
  implementation data type extension FlexibleFloatingPointExt: implementation-data-type=FlexibleFloatingPoint
    namespaces:
      symbol props genivi
      symbol props aasr
      symbol props showcase
  impl type FloatingPointPrecision: compu {0x01=Bit32, 0x02=Bit64}, implementation-data-type=UInt32
  implementation data type extension FloatingPointPrecisionExt: implementation-data-type=FloatingPointPrecision
    namespaces:
      symbol props genivi
      symbol props aasr
      symbol props showcase
  service interface IVehicles
    namespaces:
      symbol props genivi
      symbol props aasr
      symbol props showcase
    field Vehicles: type=ListOfVehicles, has-getter=true, has-notifier=true, has-setter=false
    methods:
      operation SetFloatingPointPrecision
        arg precision: type=FloatingPointPrecision, direction=IN
        arg rv: type=Boolean, direction=OUT
  impl type ListOfVehicles: category=STRUCTURE
    4 x element, all with category=TYPE_REFERENCE:
      frameId: implementation-data-type=UInt16
      frameHash: implementation-data-type=String
      detectedVehicles: implementation-data-type=VehicleVector
      boxes: implementation-data-type=BoundingBoxes
  implementation data type extension ListOfVehiclesExt: implementation-data-type=ListOfVehicles
    namespaces:
      symbol props genivi
      symbol props aasr
      symbol props showcase
  impl type Vehicle: category=STRUCTURE
    element id: implementation-data-type=UInt8
    element currentDistance: implementation-data-type=FlexibleFloatingPointContainer
    element collisionTime: implementation-data-type=FlexibleFloatingPointContainer
  implementation data type extension VehicleExt: implementation-data-type=Vehicle
    namespaces:
      symbol props genivi
      symbol props aasr
      symbol props showcase
  impl type VehicleVector: category=VECTOR
    element valueType: implementation-data-type=Vehicle
  implementation data type extension VehicleVectorExt: implementation-data-type=VehicleVector
    namespaces:
      symbol props genivi
      symbol props aasr
      symbol props showcase
